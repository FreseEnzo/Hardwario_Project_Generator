## chester/applications/input/build/Kconfig/Kconfig.modules
```kconfig
menu "vendor (/home/frese/Documents/chester-app/vendor)"
osource "/home/frese/Documents/chester-app/vendor/Kconfig"
config ZEPHYR_VENDOR_MODULE
	bool
	default y
endmenu
menu "chester (/home/frese/Documents/chester-app/chester)"
osource "/home/frese/Documents/chester-app/chester/Kconfig"
config ZEPHYR_CHESTER_MODULE
	bool
	default y
endmenu
menu "nrf (/home/frese/Documents/chester-app/nrf)"
osource "/home/frese/Documents/chester-app/nrf/Kconfig.nrf"
config ZEPHYR_NRF_MODULE
	bool
	default y
endmenu
menu "wfa-qt-control-app (/home/frese/Documents/chester-app/modules/lib/wfa-qt-control-app)"
osource "/home/frese/Documents/chester-app/modules/lib/wfa-qt-control-app/zephyr/Kconfig"
config ZEPHYR_WFA_QT_CONTROL_APP_MODULE
	bool
	default y
endmenu
menu "mcuboot (/home/frese/Documents/chester-app/bootloader/mcuboot)"
osource "$(ZEPHYR_MCUBOOT_KCONFIG)"
config ZEPHYR_MCUBOOT_MODULE
	bool
	default y
endmenu
menu "mbedtls (/home/frese/Documents/chester-app/modules/crypto/mbedtls)"
osource "$(ZEPHYR_MBEDTLS_KCONFIG)"
config ZEPHYR_MBEDTLS_MODULE
	bool
	default y
endmenu
menu "trusted-firmware-m (/home/frese/Documents/chester-app/modules/tee/tf-m/trusted-firmware-m)"
osource "$(ZEPHYR_TRUSTED_FIRMWARE_M_KCONFIG)"
config ZEPHYR_TRUSTED_FIRMWARE_M_MODULE
	bool
	default y
endmenu
menu "cjson (/home/frese/Documents/chester-app/modules/lib/cjson)"
osource "$(ZEPHYR_CJSON_KCONFIG)"
config ZEPHYR_CJSON_MODULE
	bool
	default y
endmenu
menu "azure-sdk-for-c (/home/frese/Documents/chester-app/modules/lib/azure-sdk-for-c)"
osource "$(ZEPHYR_AZURE_SDK_FOR_C_KCONFIG)"
config ZEPHYR_AZURE_SDK_FOR_C_MODULE
	bool
	default y
endmenu
menu "cirrus-logic (/home/frese/Documents/chester-app/modules/hal/cirrus-logic)"
osource "/home/frese/Documents/chester-app/modules/hal/cirrus-logic/Kconfig"
config ZEPHYR_CIRRUS_LOGIC_MODULE
	bool
	default y
endmenu
menu "openthread (/home/frese/Documents/chester-app/modules/lib/openthread)"
osource "$(ZEPHYR_OPENTHREAD_KCONFIG)"
config ZEPHYR_OPENTHREAD_MODULE
	bool
	default y
endmenu
menu "memfault-firmware-sdk (/home/frese/Documents/chester-app/modules/lib/memfault-firmware-sdk)"
osource "/home/frese/Documents/chester-app/modules/lib/memfault-firmware-sdk/ports/zephyr/Kconfig"
config ZEPHYR_MEMFAULT_FIRMWARE_SDK_MODULE
	bool
	default y
endmenu
menu "canopennode (/home/frese/Documents/chester-app/modules/lib/canopennode)"
osource "$(ZEPHYR_CANOPENNODE_KCONFIG)"
config ZEPHYR_CANOPENNODE_MODULE
	bool
	default y
endmenu
menu "chre (/home/frese/Documents/chester-app/modules/lib/chre)"
osource "/home/frese/Documents/chester-app/modules/lib/chre/platform/zephyr/Kconfig"
config ZEPHYR_CHRE_MODULE
	bool
	default y
endmenu
menu "cmsis (/home/frese/Documents/chester-app/modules/hal/cmsis)"
osource "$(ZEPHYR_CMSIS_KCONFIG)"
config ZEPHYR_CMSIS_MODULE
	bool
	default y
endmenu
menu "fatfs (/home/frese/Documents/chester-app/modules/fs/fatfs)"
osource "$(ZEPHYR_FATFS_KCONFIG)"
config ZEPHYR_FATFS_MODULE
	bool
	default y
endmenu
menu "hal_nordic (/home/frese/Documents/chester-app/modules/hal/nordic)"
osource "$(ZEPHYR_HAL_NORDIC_KCONFIG)"
config ZEPHYR_HAL_NORDIC_MODULE
	bool
	default y
endmenu
menu "liblc3 (/home/frese/Documents/chester-app/modules/lib/liblc3)"
osource "$(ZEPHYR_LIBLC3_KCONFIG)"
config ZEPHYR_LIBLC3_MODULE
	bool
	default y
endmenu
menu "littlefs (/home/frese/Documents/chester-app/modules/fs/littlefs)"
osource "$(ZEPHYR_LITTLEFS_KCONFIG)"
config ZEPHYR_LITTLEFS_MODULE
	bool
	default y
endmenu
menu "loramac-node (/home/frese/Documents/chester-app/modules/lib/loramac-node)"
osource "$(ZEPHYR_LORAMAC_NODE_KCONFIG)"
config ZEPHYR_LORAMAC_NODE_MODULE
	bool
	default y
endmenu
menu "lvgl (/home/frese/Documents/chester-app/modules/lib/gui/lvgl)"
osource "/home/frese/Documents/chester-app/modules/lib/gui/lvgl/Kconfig"
config ZEPHYR_LVGL_MODULE
	bool
	default y
endmenu
menu "lz4 (/home/frese/Documents/chester-app/modules/lib/lz4)"
osource "$(ZEPHYR_LZ4_KCONFIG)"
config ZEPHYR_LZ4_MODULE
	bool
	default y
endmenu
menu "nanopb (/home/frese/Documents/chester-app/modules/lib/nanopb)"
osource "$(ZEPHYR_NANOPB_KCONFIG)"
config ZEPHYR_NANOPB_MODULE
	bool
	default y
endmenu
menu "picolibc (/home/frese/Documents/chester-app/modules/lib/picolibc)"
osource "/home/frese/Documents/chester-app/modules/lib/picolibc/zephyr/Kconfig"
config ZEPHYR_PICOLIBC_MODULE
	bool
	default y
endmenu
menu "segger (/home/frese/Documents/chester-app/modules/debug/segger)"
osource "$(ZEPHYR_SEGGER_KCONFIG)"
config ZEPHYR_SEGGER_MODULE
	bool
	default y
endmenu
menu "TraceRecorder (/home/frese/Documents/chester-app/modules/debug/TraceRecorder)"
osource "/home/frese/Documents/chester-app/modules/debug/TraceRecorder/kernelports/Zephyr/Kconfig"
config ZEPHYR_TRACERECORDER_MODULE
	bool
	default y
endmenu
menu "uoscore-uedhoc (/home/frese/Documents/chester-app/modules/lib/uoscore-uedhoc)"
osource "$(ZEPHYR_UOSCORE_UEDHOC_KCONFIG)"
config ZEPHYR_UOSCORE_UEDHOC_MODULE
	bool
	default y
endmenu
menu "zcbor (/home/frese/Documents/chester-app/modules/lib/zcbor)"
osource "$(ZEPHYR_ZCBOR_KCONFIG)"
config ZEPHYR_ZCBOR_MODULE
	bool
	default y
endmenu
menu "zscilib (/home/frese/Documents/chester-app/modules/lib/zscilib)"
osource "/home/frese/Documents/chester-app/modules/lib/zscilib/Kconfig.zscilib"
config ZEPHYR_ZSCILIB_MODULE
	bool
	default y
endmenu
menu "nrfxlib (/home/frese/Documents/chester-app/nrfxlib)"
osource "/home/frese/Documents/chester-app/nrfxlib/Kconfig.nrfxlib"
config ZEPHYR_NRFXLIB_MODULE
	bool
	default y
endmenu
menu "connectedhomeip (/home/frese/Documents/chester-app/modules/lib/matter)"
osource "/home/frese/Documents/chester-app/modules/lib/matter/config/nrfconnect/chip-module/Kconfig"
config ZEPHYR_CONNECTEDHOMEIP_MODULE
	bool
	default y
endmenu
```

## chester/applications/input/build/Kconfig/Kconfig.shield.defconfig
```kconfig
osource "/home/frese/Documents/chester-app/chester/boards/shields/*/Kconfig.defconfig"
osource "/home/frese/Documents/chester-app/nrf/boards/shields/*/Kconfig.defconfig"
```

## chester/applications/input/build/Kconfig/Kconfig.sysbuild.modules
```kconfig
menu "nrf (/home/frese/Documents/chester-app/nrf)"
osource "/home/frese/Documents/chester-app/nrf/sysbuild/Kconfig.sysbuild"
config ZEPHYR_NRF_MODULE
	bool
	default y
endmenu
```

## chester/applications/input/build/mcuboot/Kconfig/Kconfig.shield
```kconfig
osource "/home/frese/Documents/chester-app/chester/boards/shields/*/Kconfig.shield"
osource "/home/frese/Documents/chester-app/nrf/boards/shields/*/Kconfig.shield"
```

## chester/west.yml
```yaml
manifest:
  version: "0.12"
  self:
    path: chester
    west-commands: scripts/west-commands.yml
```
