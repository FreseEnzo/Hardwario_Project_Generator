## CMakeLists.txt
```
#
# Copyright (c) 2024 HARDWARIO a.s.
#
#  SPDX-License-Identifier: LicenseRef-HARDWARIO-5-Clause
#

cmake_minimum_required(VERSION 3.20.0)

set(ENV{FW_BUNDLE} "com.hardwario.chester")
set(ENV{FW_VERSION} "v1.0.0")
set(ENV{FW_NAME} "CHESTER test")

find_package(Zephyr REQUIRED HINTS $ENV{ZEPHYR_BASE})

project(chester-test)

target_sources(app PRIVATE src/app_shell.c)
target_sources(app PRIVATE src/app_config.c)
```

## Kconfig
```
#
# Copyright (c) 2024 HARDWARIO a.s.
#
# SPDX-License-Identifier: LicenseRef-HARDWARIO-5-Clause
#

menu "Application"

# METEO Project #
# LTE #
config SHIELD_CTR_LTE
	bool "Enable SHIELD_CTR_LTE"
	default y 

config CTR_LTE
	default y
# LRW #
config SHIELD_CTR_LRW
	bool "Enable SHIELD_CTR_LRW"
	default y 

config CTR_LRW
	default y

endmenu

menu "Zephyr Kernel"
source "Kconfig.zephyr"
endmenu
```

## prj.conf
```kconfig
#
# Copyright (c) 2024 HARDWARIO a.s.
#
#  SPDX-License-Identifier: LicenseRef-HARDWARIO-5-Clause
#

# Configurations #
CONFIG_ADC_SHELL=y
CONFIG_CTR_ACCEL=y
CONFIG_CTR_BATT=y
CONFIG_CTR_BUTTON=y
CONFIG_CTR_BLE=y
CONFIG_CTR_BUF=y
CONFIG_CTR_DEFAULTS=y
CONFIG_CTR_INFO=y
CONFIG_CTR_LED=y
CONFIG_CTR_LOG=y
CONFIG_CTR_RTC=y
CONFIG_CTR_THERM=y
CONFIG_CTR_WDOG=y
CONFIG_TINYCRYPT=y
CONFIG_TINYCRYPT_SHA256=y
CONFIG_ZCBOR=y
CONFIG_ZCBOR_STOP_ON_ERROR=y
CONFIG_CTR_LTE_CLKSYNC=y

# Extra configurations #
CONFIG_ADC_TLA2021_INIT_PRIORITY=60
CONFIG_ADC_NRFX_SAADC=n
CONFIG_ADC_SHELL=n
CONFIG_NEWLIB_LIBC_NANO=n

# USER CODE BEGIN Config 
# USER CODE END Config 
```

## app.overlay
```dts
/*
 * Copyright (c) 2024 HARDWARIO a.s.
 *
 * SPDX-License-Identifier: LicenseRef-HARDWARIO-5-Clause
 */

/* METEO Project */
/* LTE  */
&ctr_lte_if {
	status = "okay";
};

&uart0 {
	status = "okay";
};
/* LRW   */
&ctr_lrw_if {
	status = "okay";
};

&uart1 {
	status = "okay";
};
```

## src/app_config.c
```c
/*
 * Copyright (c) 2024 HARDWARIO a.s.
 *
 * SPDX-License-Identifier: LicenseRef-HARDWARIO-5-Clause
 */

#include "app_config.h"

/* CHESTER includes */
#include <chester/ctr_config.h>

/* Zephyr includes */
#include <zephyr/init.h>
#include <zephyr/kernel.h>
#include <zephyr/logging/log.h>
#include <zephyr/settings/settings.h>
#include <zephyr/shell/shell.h>

/* Standard includes */
#include <ctype.h>
#include <stdbool.h>
#include <stdio.h>
#include <stdlib.h>
#include <string.h>

/* USER CODE BEGIN Includes */
/* USER CODE END Includes */

LOG_MODULE_REGISTER(app_config, LOG_LEVEL_DBG);

#define SETTINGS_PFX "chester-test"

struct app_config g_app_config;

static struct app_config m_app_config_interim = {
	.interval_sample = 60,
	.hygro_t_alarm_hi_thr = 12.45,
	.apn = "onomondo",
	.mode = APP_CONFIG_MODE_LTE,

	/* USER CODE BEGIN Struct Variables */
	/* USER CODE END Struct Variables */
};

/* USER CODE BEGIN Variables */
/* USER CODE END Variables */
static void print_app_config_mode(const struct shell *shell)
{
	const char *mode;
	switch (m_app_config_interim.mode) {
	case APP_CONFIG_MODE_NONE:
		mode = "none";
		break;
	case APP_CONFIG_MODE_LTE:
		mode = "lte";
		break;
	case APP_CONFIG_MODE_LRW:
		mode = "lrw";
		break;
	default:
		mode = "(unknown)";
		break;
	}

	shell_print(shell, "app config mode %s", mode);
}

int app_config_cmd_config_mode(const struct shell *shell, size_t argc, char **argv)
{
	if (argc == 1) {
		print_app_config_mode(shell);
		return 0;
	}

	if (argc == 2) {
		if (!strcmp("none", argv[1])) {
			m_app_config_interim.mode = APP_CONFIG_MODE_NONE;
			return 0;
		}

		if (!strcmp("lte", argv[1])) {
			m_app_config_interim.mode = APP_CONFIG_MODE_LTE;
			return 0;
		}

		if (!strcmp("lrw", argv[1])) {
			m_app_config_interim.mode = APP_CONFIG_MODE_LRW;
			return 0;
		}

		shell_error(shell, "invalid option");

		return -EINVAL;
	}

	shell_help(shell);

	return -EINVAL;
}

static void print_interval_sample(const struct shell *shell)
{
	shell_print(shell, "app config interval_sample  %d",
			m_app_config_interim.interval_sample);
}

int app_config_cmd_config_interval_sample(const struct shell *shell, size_t argc, char **argv)
{
	if (argc == 1) {
		print_interval_sample(shell);
		return 0;
	}
	if (argc == 2) {
		size_t len = strlen(argv[1]);
		for (size_t i = 0; i < len; i++) {
			if (!isdigit((int)argv[1][i])) {
				shell_error(shell, "invalid format");
				return -EINVAL;
			}
		}
		long value = strtol(argv[1], NULL, 10);
		if (value < 1 || value > 86400) {
			shell_error(shell, "invalid range");
			return -EINVAL;
		}
		m_app_config_interim.interval_sample = (int)value;
		return 0;
	}
	shell_help(shell);
	return -EINVAL;
}

static void print_hygro_t_alarm_hi_thr(const struct shell *shell)
{
	shell_print(shell, "app config hygro-t-alarm-hi-thr %.1f",
			m_app_config_interim.hygro_t_alarm_hi_thr);
}

int app_config_cmd_config_hygro_t_alarm_hi_thr(const struct shell *shell, size_t argc, char **argv)
{
	if (argc == 1) {
		print_hygro_t_alarm_hi_thr(shell);
		return 0;
	}
	if (argc == 2) {
		float value;
		int ret = sscanf(argv[1], "%f", &value);
		if (ret != 1) {
			shell_error(shell, "invalid value");
			return -EINVAL;
		}
		if (value < -40.0 || value > 125.0) 
		{
			shell_error(shell, "invalid range");
			return -EINVAL;
		}
		m_app_config_interim.hygro_t_alarm_hi_thr = value;
		return 0;
	}
	shell_help(shell);
	return -EINVAL;
}

static void print_apn(const struct shell *shell)
{
	shell_print(shell, "lte config apn %.1f",
			m_app_config_interim.apn);
}

int app_config_cmd_config_apn(const struct shell *shell, size_t argc, char **argv)
{
	if (argc == 1) {
		print_apn(shell);
		return 0;
	}
	if (argc == 2) {
			size_t len = strlen(argv[1]);

			if (len >= sizeof(m_config_interim.apn)) {
				shell_error(shell, "invalid format");
				return -EINVAL;
			}

			for (size_t i = 0; i < len; i++) {
				char c = argv[1][i];
				if (!isalnum((int)c) && c != '-' && c != '.') {
					shell_error(shell, "invalid format");
					return -EINVAL;
				}
			}

			strcpy(m_config_interim.apn, argv[1]);
			return 0;
		}
	shell_help(shell);
	return -EINVAL;
}

static void print_hygro_t_alarm_lo_report(const struct shell *shell)
{
	shell_print(shell, "app config hygro-t-alarm-lo-report  %s",
			m_app_config_interim.hygro_t_alarm_lo_report ? "true" : "false");
}

int app_config_cmd_config_hygro_t_alarm_lo_report(const struct shell *shell, size_t argc, char **argv)
{
	if (argc == 1) {
		print_hygro_t_alarm_lo_report(shell);                                                    
		return 0;
	}
	if (argc == 2) {
		bool is_false = !strcmp(argv[1], "false");
		bool is_true = !strcmp(argv[1], "true");
		if (is_false) {
			m_app_config_interim.hygro_t_alarm_lo_report = false;
		} else if (is_true) {
			m_app_config_interim.hygro_t_alarm_lo_report = true;
		} else {
			shell_error(shell, "invalid format");
			return -EINVAL;
		}
		return 0;
	}
	shell_help(shell);
	return -EINVAL;
}

static void print_channel_differential(const struct shell *shell, int channel)
{
	int ch = channel;

	for (int i = ch != 0 ? ch - 1 : 0; i < (ch != 0 ? ch : 4); i++) {
		shell_print(shell, "app config channel-differential %d %s", i + 1,
				m_app_config_interim.channel_differential[i] ? "true" : "false");
	}
}

int app_config_cmd_config_channel_differential(const struct shell *shell, size_t argc, char **argv)
{
	int channel;

	if (argc >= 2) {
		unsigned long ch = strtoul(argv[1], NULL, 10);

		if (ch < 0 || ch > 4) {
			shell_error(shell, "invalid channel index");
			return -EINVAL;
		}

		channel = ch;
	}

	if (argc == 2) {
		print_channel_differential(shell, channel);
		return 0;
	}

	if (argc == 3 && strcmp(argv[2], "true") == 0) {
		int ch = channel;

		for (int i = ch != 0 ? ch - 1 : 0; i < (ch != 0 ? ch : 4);
			 i++) {
			m_app_config_interim.channel_differential[i] = true;
		}

		return 0;
	}

	if (argc == 3 && strcmp(argv[2], "false") == 0) {
		int ch = channel;

		for (int i = ch != 0 ? ch - 1 : 0; i < (ch != 0 ? ch : 4);
			 i++) {
			m_app_config_interim.channel_differential[i] = false;
		}

		return 0;
	}

	shell_help(shell);
	return -EINVAL;
}

static void print_channel_calib_x0(const struct shell *shell, int channel)
{
	int ch = channel;

	for (int i = ch != 0 ? ch - 1 : 0; i < (ch != 0 ? ch : 4); i++) {
		shell_print(shell, "app config channel-calib-x0 %d %d", i + 1,
				m_app_config_interim.channel_calib_x0[i]);
	}
}

int app_config_cmd_config_channel_calib_x0(const struct shell *shell, size_t argc, char **argv)
{
	int channel;

	if (argc >= 2) {
		unsigned long ch = strtoul(argv[1], NULL, 10);

		if (ch < 0 || ch > 4) {
			shell_error(shell, "invalid channel index");
			return -EINVAL;
		}

		channel = ch;
	}

	if (argc == 2) {
		print_channel_calib_x0(shell, channel);
		return 0;
	}

	if (argc == 3) {
		long long val = strtoll(argv[2], NULL, 10);
		if (val < 30 || val > 86400) {
			shell_error(shell, "invalid range");
			return -EINVAL;
		}

		int ch = channel;

		for (int i = ch != 0 ? ch - 1 : 0; i < (ch != 0 ? ch : 4);
			 i++) {
			m_app_config_interim.channel_calib_x0[i] = val;
		}

		return 0;
	}

	shell_help(shell);
	return -EINVAL;
}

int app_config_cmd_config_show(const struct shell *shell, size_t argc, char **argv)
{
	print_app_config_mode(shell);
	print_interval_sample(shell);
	print_hygro_t_alarm_hi_thr(shell);
	print_apn(shell);
	print_hygro_t_alarm_lo_report(shell);
	print_channel_differential(shell, 0);
	print_channel_calib_x0(shell, 0);
	
	return 0;
}

/* USER CODE BEGIN Functions 1 */
/* USER CODE END Functions 1 */

static int h_commit(void)
{
	LOG_DBG("Loaded settings in full");
	memcpy(&g_app_config, &m_app_config_interim, sizeof(g_app_config));

	return 0;
}

static int h_set(const char *key, size_t len, settings_read_cb read_cb, void *cb_arg) 
{
	int ret;
	const char *next;
	if (settings_name_steq(key, "mode", &next) && !next) {
		if (len != sizeof(m_app_config_interim.mode)) {
			return -EINVAL;
		}
		ret = read_cb(cb_arg, &m_app_config_interim.mode, len);
		if (ret < 0) {
			LOG_ERR("Call `read_cb` failed: %d", ret);
			return ret;
		}
		return 0;
	}
	
	if (settings_name_steq(key, "interval_sample", &next) && !next) {
		if (len != sizeof(m_app_config_interim.interval_sample)) {
			return -EINVAL;
		}
		ret = read_cb(cb_arg, &m_app_config_interim.interval_sample, len);
		if (ret < 0) {
			LOG_ERR("Call `read_cb` failed: %d", ret);
			return ret;
		}
		return 0;
	}

	if (settings_name_steq(key, "hygro-t-alarm-hi-thr", &next) && !next) {
		if (len != sizeof(m_app_config_interim.hygro_t_alarm_hi_thr)) {
			return -EINVAL;
		}
		ret = read_cb(cb_arg, &m_app_config_interim.hygro_t_alarm_hi_thr, len);
		if (ret < 0) {
			LOG_ERR("Call `read_cb` failed: %d", ret);
			return ret;
		}
		return 0;
	}

	if (settings_name_steq(key, "apn", &next) && !next) {
		if (len != sizeof(m_app_config_interim.apn)) {
			return -EINVAL;
		}
		ret = read_cb(cb_arg, &m_app_config_interim.apn, len);
		if (ret < 0) {
			LOG_ERR("Call `read_cb` failed: %d", ret);
			return ret;
		}
		return 0;
	}

	if (settings_name_steq(key, "hygro-t-alarm-lo-report", &next) && !next) {
		if (len != sizeof(m_app_config_interim.hygro_t_alarm_lo_report)) {
			return -EINVAL;
		}
		ret = read_cb(cb_arg, &m_app_config_interim.hygro_t_alarm_lo_report, len);
		if (ret < 0) {
			LOG_ERR("Call `read_cb` failed: %d", ret);
			return ret;
		}
		return 0;
	}

	if (settings_name_steq(key, "channel-0-differential", &next) && !next) {
		if (len != sizeof(m_app_config_interim.channel_differential[0])) {
			return -EINVAL;
		}
		ret = read_cb(cb_arg, &m_app_config_interim.channel_differential[0], len);
		if (ret < 0) {
			LOG_ERR("Call `read_cb` failed: %d", ret);
			return ret;
		}
		return 0;
	}    

	if (settings_name_steq(key, "channel-1-differential", &next) && !next) {
		if (len != sizeof(m_app_config_interim.channel_differential[1])) {
			return -EINVAL;
		}
		ret = read_cb(cb_arg, &m_app_config_interim.channel_differential[1], len);
		if (ret < 0) {
			LOG_ERR("Call `read_cb` failed: %d", ret);
			return ret;
		}
		return 0;
	}    

	if (settings_name_steq(key, "channel-2-differential", &next) && !next) {
		if (len != sizeof(m_app_config_interim.channel_differential[2])) {
			return -EINVAL;
		}
		ret = read_cb(cb_arg, &m_app_config_interim.channel_differential[2], len);
		if (ret < 0) {
			LOG_ERR("Call `read_cb` failed: %d", ret);
			return ret;
		}
		return 0;
	}    

	if (settings_name_steq(key, "channel-3-differential", &next) && !next) {
		if (len != sizeof(m_app_config_interim.channel_differential[3])) {
			return -EINVAL;
		}
		ret = read_cb(cb_arg, &m_app_config_interim.channel_differential[3], len);
		if (ret < 0) {
			LOG_ERR("Call `read_cb` failed: %d", ret);
			return ret;
		}
		return 0;
	}    

	if (settings_name_steq(key, "channel-0-calib-x0", &next) && !next) {
		if (len != sizeof(m_app_config_interim.channel_calib_x0[0])) {
			return -EINVAL;
		}
		ret = read_cb(cb_arg, &m_app_config_interim.channel_calib_x0[0], len);
		if (ret < 0) {
			LOG_ERR("Call `read_cb` failed: %d", ret);
			return ret;
		}
		return 0;
	}    

	if (settings_name_steq(key, "channel-1-calib-x0", &next) && !next) {
		if (len != sizeof(m_app_config_interim.channel_calib_x0[1])) {
			return -EINVAL;
		}
		ret = read_cb(cb_arg, &m_app_config_interim.channel_calib_x0[1], len);
		if (ret < 0) {
			LOG_ERR("Call `read_cb` failed: %d", ret);
			return ret;
		}
		return 0;
	}    

	if (settings_name_steq(key, "channel-2-calib-x0", &next) && !next) {
		if (len != sizeof(m_app_config_interim.channel_calib_x0[2])) {
			return -EINVAL;
		}
		ret = read_cb(cb_arg, &m_app_config_interim.channel_calib_x0[2], len);
		if (ret < 0) {
			LOG_ERR("Call `read_cb` failed: %d", ret);
			return ret;
		}
		return 0;
	}    

	if (settings_name_steq(key, "channel-3-calib-x0", &next) && !next) {
		if (len != sizeof(m_app_config_interim.channel_calib_x0[3])) {
			return -EINVAL;
		}
		ret = read_cb(cb_arg, &m_app_config_interim.channel_calib_x0[3], len);
		if (ret < 0) {
			LOG_ERR("Call `read_cb` failed: %d", ret);
			return ret;
		}
		return 0;
	}    

	/* USER CODE BEGIN Functions 2 */
	/* USER CODE END Functions 2 */

	return 0;
}

static int h_export(int (*export_func)(const char *name, const void *val, size_t val_len))
{
	int ret;
	ret = export_func("chester-test/mode", &m_app_config_interim.mode,
					  sizeof( m_app_config_interim.mode));
	if (ret < 0) {
		return ret;
	}

	ret = export_func("chester-test/interval_sample", &m_app_config_interim.interval_sample,
					  sizeof( m_app_config_interim.interval_sample));
	if (ret < 0) {
		return ret;
	}

	ret = export_func("chester-test/hygro-t-alarm-hi-thr", &m_app_config_interim.hygro_t_alarm_hi_thr,
					  sizeof( m_app_config_interim.hygro_t_alarm_hi_thr));
	if (ret < 0) {
		return ret;
	}

	ret = export_func("chester-test/apn", &m_app_config_interim.apn,
					  sizeof( m_app_config_interim.apn));
	if (ret < 0) {
		return ret;
	}

	ret = export_func("chester-test/hygro-t-alarm-lo-report", &m_app_config_interim.hygro_t_alarm_lo_report,
					  sizeof( m_app_config_interim.hygro_t_alarm_lo_report));
	if (ret < 0) {
		return ret;
	}

	ret = export_func("chester-test/channel-0-differential", &m_app_config_interim.channel_differential[0],
					  sizeof( m_app_config_interim.channel_differential[0]));
	if (ret < 0) {
		return ret;
	}
	
	ret = export_func("chester-test/channel-1-differential", &m_app_config_interim.channel_differential[1],
					  sizeof( m_app_config_interim.channel_differential[1]));
	if (ret < 0) {
		return ret;
	}
	
	ret = export_func("chester-test/channel-2-differential", &m_app_config_interim.channel_differential[2],
					  sizeof( m_app_config_interim.channel_differential[2]));
	if (ret < 0) {
		return ret;
	}
	
	ret = export_func("chester-test/channel-3-differential", &m_app_config_interim.channel_differential[3],
					  sizeof( m_app_config_interim.channel_differential[3]));
	if (ret < 0) {
		return ret;
	}
	
	ret = export_func("chester-test/channel-0-calib-x0", &m_app_config_interim.channel_calib_x0[0],
					  sizeof( m_app_config_interim.channel_calib_x0[0]));
	if (ret < 0) {
		return ret;
	}
	
	ret = export_func("chester-test/channel-1-calib-x0", &m_app_config_interim.channel_calib_x0[1],
					  sizeof( m_app_config_interim.channel_calib_x0[1]));
	if (ret < 0) {
		return ret;
	}
	
	ret = export_func("chester-test/channel-2-calib-x0", &m_app_config_interim.channel_calib_x0[2],
					  sizeof( m_app_config_interim.channel_calib_x0[2]));
	if (ret < 0) {
		return ret;
	}
	
	ret = export_func("chester-test/channel-3-calib-x0", &m_app_config_interim.channel_calib_x0[3],
					  sizeof( m_app_config_interim.channel_calib_x0[3]));
	if (ret < 0) {
		return ret;
	}
	
	/* USER CODE BEGIN Functions 3 */
	/* USER CODE END Functions 3 */

	return 0;
}

static int init(void) 
{
	int ret;

	LOG_INF("System initialization");

	static struct settings_handler sh = {
		.name = SETTINGS_PFX,
		.h_set = h_set,
		.h_commit = h_commit,
		.h_export = h_export,
	};

	ret = settings_register(&sh);

	if (ret < 0) {
		LOG_ERR("Call `settings_register` failed: %d", ret);
		return ret;
	}

	ret = settings_load_subtree(SETTINGS_PFX);

	if (ret < 0) {
		LOG_ERR("Call `settings_load_subtree` failed: %d", ret);
		return ret;
	}

	ctr_config_append_show(SETTINGS_PFX, app_config_cmd_config_show);

	/* USER CODE BEGIN Functions 4 */
	/* USER CODE END Functions 4 */

	return 0;
}

SYS_INIT(init, APPLICATION, CONFIG_APPLICATION_INIT_PRIORITY);
```

## src/app_config.h
```c
/*
 * Copyright (c) 2024 HARDWARIO a.s.
 *
 * SPDX-License-Identifier: LicenseRef-HARDWARIO-5-Clause
 */

#ifndef APP_CONFIG_H_
#define APP_CONFIG_H_

/* Zephyr includes */
#include <zephyr/shell/shell.h>

/* Standard includes */
#include <stdbool.h>
#include <stddef.h>

/* USER CODE BEGIN Includes */
/* USER CODE END Includes */

#ifdef __cplusplus
extern "C" {
#endif
enum app_config_mode {
	APP_CONFIG_MODE_NONE = 0,
	APP_CONFIG_MODE_LTE = 1,
	APP_CONFIG_MODE_LRW = 2,
};

struct app_config {
	enum app_config_mode mode;
	int interval_sample;
	float hygro_t_alarm_hi_thr;
	char apn [9];
		
	bool hygro_t_alarm_lo_report;
	bool channel_differential[4];
	int channel_calib_x0[4];

	/* USER CODE BEGIN Struct Variables */
	/* USER CODE END Struct Variables */
};

extern struct app_config g_app_config;

/* USER CODE BEGIN Variables */
/* USER CODE END Variables */
int app_config_cmd_config_mode(const struct shell *shell, size_t argc, char **argv);
int app_config_cmd_config_show(const struct shell *shell, size_t argc, char **argv);
int app_config_cmd_config_interval_sample(const struct shell *shell, size_t argc, char **argv);
int app_config_cmd_config_hygro_t_alarm_hi_thr(const struct shell *shell, size_t argc, char **argv);
int app_config_cmd_config_hygro_t_alarm_lo_report(const struct shell *shell, size_t argc, char **argv);
int app_config_cmd_config_channel_differential(const struct shell *shell, size_t argc, char **argv);
int app_config_cmd_config_channel_calib_x0(const struct shell *shell, size_t argc, char **argv);

/* USER CODE BEGIN Functions 1 */
/* USER CODE END Functions 1 */

#ifdef __cplusplus
}
#endif

#endif /* APP_CONFIG_H_ */
```

## src/app_shell.c
```c
/*
 * Copyright (c) 2024 HARDWARIO a.s.
 *
 * SPDX-License-Identifier: LicenseRef-HARDWARIO-5-Clause
 */

#include "app_config.h"
#include "app_work.h"

/* Zephyr includes */
#include <zephyr/kernel.h>
#include <zephyr/logging/log.h>
#include <zephyr/shell/shell.h>

/* Standard includes */
#include <errno.h>
#include <stdlib.h>

/* USER CODE BEGIN Includes */
/* USER CODE END Includes */

LOG_MODULE_REGISTER(app_shell, LOG_LEVEL_INF);static int cmd_read(const struct shell *shell, size_t argc, char **argv)
{
	int ret;

	if (argc > 1) {
		shell_error(shell, "unknown parameter: %s", argv[1]);
		shell_help(shell);
		return -EINVAL;
	}

	return 0;
}

static int cmd_sample(const struct shell *shell, size_t argc, char **argv)
{
	if (argc > 1) {
		shell_error(shell, "unknown parameter: %s", argv[1]);
		shell_help(shell);
		return -EINVAL;
	}

	app_work_sample();

	return 0;
}

static int cmd_send(const struct shell *shell, size_t argc, char **argv)
{
	if (argc > 1) {
		shell_error(shell, "unknown parameter: %s", argv[1]);
		shell_help(shell);
		return -EINVAL;
	}

	app_work_send();

	return 0;
}

static int cmd_aggreg(const struct shell *shell, size_t argc, char **argv)
{
	if (argc > 1) {
		shell_error(shell, "unknown parameter: %s", argv[1]);
		shell_help(shell);
		return -EINVAL;
	}

	app_work_aggreg();

	return 0;
}

static int print_help(const struct shell *shell, size_t argc, char **argv)
{
	if (argc > 1) {
		shell_error(shell, "command not found: %s", argv[1]);
		shell_help(shell);
		return -EINVAL;
	}

	shell_help(shell);
	return 0;
}

/* clang-format off */

SHELL_STATIC_SUBCMD_SET_CREATE(
	sub_app_config,
   
	SHELL_CMD_ARG(show, NULL,
				  "List current configuration.",
				  app_config_cmd_config_show, 1, 0),
	
	SHELL_CMD_ARG(mode, NULL,
				  "Get/Set communication mode (None/LTE/LoRaWAN) ('none', 'lte', 'lrw').",
				  app_config_cmd_config_mode, 1, 1),
	SHELL_CMD_ARG(interval_sample, NULL,
				  "Get/Set sample interval in seconds (format: <1-86400>).",
				  app_config_cmd_config_interval_sample, 1, 1),
	
	SHELL_CMD_ARG(hygro-t-alarm-hi-thr, NULL,
				  "Get/Set hygro high temperature alarm threshold (format: <-40.0..125.0>).",
				  app_config_cmd_config_hygro_t_alarm_hi_thr, 1, 1),
	
	SHELL_CMD_ARG(apn, NULL,
				  "Set APN network name",
				  app_config_cmd_config_apn, 1, 1),
	
	SHELL_CMD_ARG(hygro-t-alarm-lo-report, NULL,
				  "Get/Set report when hygro low temperature alarm is crossed (format: true, false).",
				  app_config_cmd_config_hygro_t_alarm_lo_report, 1, 1),
	
	SHELL_CMD_ARG(channel-differential, NULL,
				"Get/Set channel differential mode (format: <channel> <true|false>).",
				app_config_cmd_config_channel_differential, 2, 1),
	
	SHELL_CMD_ARG(channel-calib-x0, NULL,
				"Get/Set channel X0 calibration point (format: <channel> <-2147483648..2147483647>).",
				app_config_cmd_config_channel_calib_x0, 2, 1),
	
	/* USER CODE BEGIN Functions 1 */
	/* USER CODE END Functions 1 */

	SHELL_SUBCMD_SET_END
);

SHELL_STATIC_SUBCMD_SET_CREATE(
	sub_app,

	SHELL_CMD_ARG(config, &sub_app_config, "Configuration commands.",
				  print_help, 1, 0),
		
	SHELL_SUBCMD_SET_END

/* USER CODE BEGIN Functions 2 */
/* USER CODE END Functions 2 */

);

SHELL_CMD_REGISTER(app, &sub_app, "Application commands.", print_help);

SHELL_CMD_REGISTER(sample, NULL,"Sample immediately.", cmd_sample);
SHELL_CMD_REGISTER(send, NULL,"Send data immediately.", cmd_send);
SHELL_CMD_REGISTER(aggreg, NULL,"Aggregate data immediately", cmd_aggreg);

/* USER CODE BEGIN Functions 3 */
/* USER CODE END Functions 3 */

/* clang-format on */
```
