## CMakeLists.txt
```
#
# Copyright (c) 2024 HARDWARIO a.s.
#
# SPDX-License-Identifier: LicenseRef-HARDWARIO-5-Clause
#

cmake_minimum_required(VERSION 3.20.0)

# Supported shields: ctr_ds18b20 ctr_lte ctr_x0_a ctr_z 
set(SHIELD ctr_ds18b20 ctr_lte ctr_x0_a ctr_z)

find_package(Zephyr REQUIRED HINTS $ENV{ZEPHYR_BASE})
project(CHESTER Clime)


target_sources(app PRIVATE src/app_config.c)
target_sources(app PRIVATE src/app_shell.c)
```

## prj.conf
```kconfig
#
# Copyright (c) 2023 HARDWARIO a.s.
#
# SPDX-License-Identifier: LicenseRef-HARDWARIO-5-Clause
#

CONFIG_CTR_BLE=y
CONFIG_CTR_LTE_CLKSYNC=y
CONFIG_CTR_LRW=y
CONFIG_CTR_SHELL=y
CONFIG_CTR_LED=y
CONFIG_CTR_BUTTON=y
```

## src/app_config.c
```c
/*
 * Copyright (c) 2023 HARDWARIO a.s.
 *
 * SPDX-License-Identifier: LicenseRef-HARDWARIO-5-Clause
 */
#include "app_config.h"

/* CHESTER includes */
#include <chester/ctr_config.h>

/* Zephyr includes */
#include <zephyr/init.h>
#include <zephyr/kernel.h>
#include <zephyr/logging/log.h>
#include <zephyr/settings/settings.h>
#include <zephyr/shell/shell.h>

/* Standard includes */
#include <ctype.h>
#include <stdbool.h>
#include <stdio.h>
#include <stdlib.h>
#include <string.h>

LOG_MODULE_REGISTER(app_config, LOG_LEVEL_DBG);

#define SETTINGS_PFX "CHESTER Clime"

struct app_config g_app_config;

static struct app_config g_app_config = {

    .report_interval = 3600,
    .counter_interval_aggreg = 25,
    .apn = "onomondo",
    .debug_mode = True,
    .temperature = 24.54,
};


static void print_report_interval(const struct shell *shell)
{
    shell_print(shell, "app config  report-interval  %d", m_app_config_interim.report_interval);
}

int app_config_cmd_config_report_interval(const struct shell *shell, size_t argc, char **argv)
{
    if (argc == 1) {
        print_report_interval(shell);
        return 0;
    }
    if (argc == 2) {
        size_t len = strlen(argv[1]);
        for (size_t i = 0; i < len; i++) {
            if (!isdigit((int)argv[1][i])) {
                shell_error(shell, "invalid format");
                return -EINVAL;
            }
        }
        long value = strtol(argv[1], NULL, 10);
        if (value < 0 || value > 40000) {
            shell_error(shell, "invalid range");
            return -EINVAL;
        }
        m_app_config_interim.report_interval = (int)value;
        return 0;
    }
    shell_help(shell);
    return -EINVAL;
}

static void print_counter_interval_aggreg(const struct shell *shell)
{
    shell_print(shell, "app config  counter-interval-aggreg  %d", m_app_config_interim.counter_interval_aggreg);
}

int app_config_cmd_config_counter_interval_aggreg(const struct shell *shell, size_t argc, char **argv)
{
    if (argc == 1) {
        print_counter_interval_aggreg(shell);
        return 0;
    }
    if (argc == 2) {
        size_t len = strlen(argv[1]);
        for (size_t i = 0; i < len; i++) {
            if (!isdigit((int)argv[1][i])) {
                shell_error(shell, "invalid format");
                return -EINVAL;
            }
        }
        long value = strtol(argv[1], NULL, 10);
        if (value < 32 || value > 324) {
            shell_error(shell, "invalid range");
            return -EINVAL;
        }
        m_app_config_interim.counter_interval_aggreg = (int)value;
        return 0;
    }
    shell_help(shell);
    return -EINVAL;
}

static void print_apn(const struct shell *shell)
{
    shell_print(shell, "app config apn %.1f", m_app_config_interim.apn);
}

int app_config_cmd_config_apn(const struct shell *shell, size_t argc, char **argv)
{
    if (argc == 1) {
        print_apn(shell);
        return 0;
    }
    if (argc == 2) {
            size_t len = strlen(argv[1]);

            if (len >= sizeof(m_config_interim.apn)) {
                shell_error(shell, "invalid format");
                return -EINVAL;
            }

            for (size_t i = 0; i < len; i++) {
                char c = argv[1][i];
                if (!isalnum((int)c) && c != '-' && c != '.') {
                    shell_error(shell, "invalid format");
                    return -EINVAL;
                }
            }

            strcpy(m_config_interim.apn, argv[1]);
            return 0;
        }
    shell_help(shell);
    return -EINVAL;
}

static void print_debug_mode(const struct shell *shell)
{
    shell_print(shell, "app config debug-mode  %s", m_app_config_interim.debug_mode ? "true" : "false");
}

int app_config_cmd_config_debug_mode(const struct shell *shell, size_t argc, char **argv)
{
    if (argc == 1) {
        print_debug_mode(shell);                                                    
        return 0;
    }
    if (argc == 2) {
        bool is_false = !strcmp(argv[1], "false");
        bool is_true = !strcmp(argv[1], "true");
        if (is_false) {
            m_app_config_interim.debug_mode = false;
        } else if (is_true) {
            m_app_config_interim.debug_mode = true;
        } else {
            shell_error(shell, "invalid format");
            return -EINVAL;
        }
        return 0;
    }
    shell_help(shell);
    return -EINVAL;
}

static void print_temperature(const struct shell *shell)
{
    shell_print(shell, "app config temperature %.1f", m_app_config_interim.temperature);
}

int app_config_cmd_config_temperature(const struct shell *shell, size_t argc, char **argv)
{
    if (argc == 1) {
        print_temperature(shell);
        return 0;
    }
    if (argc == 2) {
        float value;
        int ret = sscanf(argv[1], "%f", &value);
        if (ret != 1) {
            shell_error(shell, "invalid value");
            return -EINVAL;
        }
        if (value <  || value > ) {
            shell_error(shell, "invalid range");
            return -EINVAL;
        }
        m_app_config_interim.temperature = value;
        return 0;
    }
    shell_help(shell);
    return -EINVAL;
}

// Function to handle setting configurations
static int set_setting(const char *key, size_t len, settings_read_cb read_cb, void *cb_arg) {
    int ret;
    const char *next;
if (settings_name_steq(key, "report-interval", &next) && !next) {
            if (len != sizeof(m_app_config_interim.report_interval)) {
                return -EINVAL;
            }
            ret = read_cb(cb_arg, &m_app_config_interim.report_interval, len);
            if (ret < 0) {
                LOG_ERR("Call `read_cb` failed: %d", ret);
                return ret;
            }
            return 0;
        }

if (settings_name_steq(key, "counter-interval-aggreg", &next) && !next) {
            if (len != sizeof(m_app_config_interim.counter_interval_aggreg)) {
                return -EINVAL;
            }
            ret = read_cb(cb_arg, &m_app_config_interim.counter_interval_aggreg, len);
            if (ret < 0) {
                LOG_ERR("Call `read_cb` failed: %d", ret);
                return ret;
            }
            return 0;
        }


if (settings_name_steq(key, "debug-mode", &next) && !next) {
            if (len != sizeof(m_app_config_interim.debug_mode)) {
                return -EINVAL;
            }
            ret = read_cb(cb_arg, &m_app_config_interim.debug_mode, len);
            if (ret < 0) {
                LOG_ERR("Call `read_cb` failed: %d", ret);
                return ret;
            }
            return 0;
        }

if (settings_name_steq(key, "temperature", &next) && !next) {
            if (len != sizeof(m_app_config_interim.temperature)) {
                return -EINVAL;
            }
            ret = read_cb(cb_arg, &m_app_config_interim.temperature, len);
            if (ret < 0) {
                LOG_ERR("Call `read_cb` failed: %d", ret);
                return ret;
            }
            return 0;
        }


}
// Function to export configurations
static int export_settings(int (*export_func)(const char *name, const void *val, size_t val_len)) {
    int ret;
    if (settings_name_steq(key, "report-interval", &next) && !next) {
        if (len != sizeof(m_app_config_interim.report_interval)) {
            return -EINVAL;
        }
        ret = read_cb(cb_arg, &m_app_config_interim.report_interval, len);
        if (ret < 0) {
            LOG_ERR("Call `read_cb` failed: %d", ret);
            return ret;
        }
        return 0;
    }

    if (settings_name_steq(key, "counter-interval-aggreg", &next) && !next) {
        if (len != sizeof(m_app_config_interim.counter_interval_aggreg)) {
            return -EINVAL;
        }
        ret = read_cb(cb_arg, &m_app_config_interim.counter_interval_aggreg, len);
        if (ret < 0) {
            LOG_ERR("Call `read_cb` failed: %d", ret);
            return ret;
        }
        return 0;
    }

    if (settings_name_steq(key, "debug-mode", &next) && !next) {
        if (len != sizeof(m_app_config_interim.debug_mode)) {
            return -EINVAL;
        }
        ret = read_cb(cb_arg, &m_app_config_interim.debug_mode, len);
        if (ret < 0) {
            LOG_ERR("Call `read_cb` failed: %d", ret);
            return ret;
        }
        return 0;
    }

    if (settings_name_steq(key, "temperature", &next) && !next) {
        if (len != sizeof(m_app_config_interim.temperature)) {
            return -EINVAL;
        }
        ret = read_cb(cb_arg, &m_app_config_interim.temperature, len);
        if (ret < 0) {
            LOG_ERR("Call `read_cb` failed: %d", ret);
            return ret;
        }
        return 0;
    }
}

// Initialization function
static int init(void) {
    int ret;

    LOG_INF("System initialization");

    static struct settings_handler sh = {
        .name = SETTINGS_PFX,
        .h_set = set_setting,
        .h_commit = commit_settings,
        .h_export = export_settings,
    };

    ret = settings_register(&sh);

    if (ret < 0) {
        LOG_ERR("Call `settings_register` failed: %d", ret);
        return ret;
    }

    ret = settings_load_subtree(SETTINGS_PFX);

    if (ret < 0) {
        LOG_ERR("Call `settings_load_subtree` failed: %d", ret);
        return ret;
    }
    ctr_config_append_show(SETTINGS_PFX, app_config_cmd_config_show)
    

    return 0;
}

SYS_INIT(init, APPLICATION, CONFIG_APPLICATION_INIT_PRIORITY);
```

## src/app_config.h
```c
/*
 * Copyright (c) 2023 HARDWARIO a.s.
 *
 * SPDX-License-Identifier: LicenseRef-HARDWARIO-5-Clause
 */
#ifndef APP_CONFIG_H_
#define APP_CONFIG_H_

/* Zephyr includes */
#include <zephyr/shell/shell.h>

/* Standard includes */
#include <stdbool.h>
#include <stddef.h>

#ifdef __cplusplus
extern "C" {
#endif


struct app_config = {
    
        int report_interval;
        int counter_interval_aggreg;
        char apn [63 + 1];
        bool debug_mode;
        float temperature;
};

int app_config_cmd_config_show(const struct shell *shell, size_t argc, char **argv);
int app_config_cmd_config_report_interval(const struct shell *shell, size_t argc, char **argv);
int app_config_cmd_config_counter_interval_aggreg(const struct shell *shell, size_t argc, char **argv);
int app_config_cmd_config_debug_mode(const struct shell *shell, size_t argc, char **argv);
int app_config_cmd_config_temperature(const struct shell *shell, size_t argc, char **argv);

#ifdef __cplusplus
}
#endif

#endif /* APP_CONFIG_H_ */
```

## src/app_shell.c
```c
/*
 * Copyright (c) 2023 HARDWARIO a.s.
 *
 * SPDX-License-Identifier: LicenseRef-HARDWARIO-5-Clause
 */
#include "app_config.h"
#include "app_work.h"

/* Zephyr includes */
#include <zephyr/kernel.h>
#include <zephyr/logging/log.h>
#include <zephyr/shell/shell.h>

/* Standard includes */
#include <errno.h>
#include <stdlib.h>

LOG_MODULE_REGISTER(app_shell, LOG_LEVEL_INF);

static int print_help(const struct shell *shell, size_t argc, char **argv) {
    if (argc > 1) {
        shell_error(shell, "command not found: %s", argv[1]);
        shell_help(shell);
        return -EINVAL;
    }

    shell_help(shell);
    return 0;
}

/* clang-format off */

SHELL_STATIC_SUBCMD_SET_CREATE(
    sub_app_config,
    SHELL_CMD_ARG(show, NULL, "List current configuration.", app_config_cmd_config_show, 1, 0),
    SHELL_CMD_ARG(report-interval, NULL, "Set report interval (default: 3600)", app_config_cmd_report_interval, 1, 1),
    SHELL_CMD_ARG(counter-interval-aggreg, NULL, "Set report interval (default: 3600)", app_config_cmd_counter_interval_aggreg, 1, 1),
    SHELL_CMD_ARG(apn, NULL, "Set APN network name", app_config_cmd_apn, 1, 1),
    SHELL_CMD_ARG(debug-mode, NULL, "Set debug mode (T/F)", app_config_cmd_debug_mode, 1, 1),
    SHELL_CMD_ARG(temperature, NULL, "Set Temperature 0.0f to 50.f", app_config_cmd_temperature, 1, 1),
        
SHELL_SUBCMD_SET_END
);

SHELL_STATIC_SUBCMD_SET_CREATE(
    sub_app,

    SHELL_CMD_ARG(config, &sub_app_config, "Configuration commands.", print_help, 1, 0),
        
    SHELL_SUBCMD_SET_END
);

SHELL_CMD_REGISTER(app, &sub_app, "Application commands.", print_help);
SHELL_CMD_ARG(send, NULL, "Set report interval (default: 3600)", app_config_cmd_app_send, 1, 1),
SHELL_CMD_ARG(show, NULL, "Show all configs", app_config_cmd_show, 1, 1),
/* clang-format on */
```
